## boards/arm/lpgalaxy_le_zapybara/lpgalaxy_le_zapybara_defconfig
```kconfig
# SPDX-License-Identifier: MIT

CONFIG_SOC_SERIES_NRF52X=y
CONFIG_SOC_NRF52840_QIAA=y
CONFIG_BOARD_LPGALAXY_LE_ZAPYBARA=y

# Enable MPU
CONFIG_ARM_MPU=y

# Enable during calibration. do not use! compile error!
#CONFIG_ZMK_USB_LOGGING=y
CONFIG_LOG=y
CONFIG_ZMK_LOG_LEVEL_DBG=y
CONFIG_LOG_PRINTK=y
CONFIG_LOG_MODE_DEFERRED=y  # Critical for ISR safety

# enable GPIO
CONFIG_PINCTRL=y
CONFIG_GPIO=y
CONFIG_ADC=y

CONFIG_ZMK_USB=y
CONFIG_ZMK_BLE=y

# Don't use for now, until the accelerometer waker is working.
# CONFIG_ZMK_SLEEP=y

CONFIG_USE_DT_CODE_PARTITION=y
CONFIG_BUILD_OUTPUT_UF2=y

CONFIG_MPU_ALLOW_FLASH_WRITE=y
CONFIG_NVS=y
CONFIG_SETTINGS_NVS=y
CONFIG_FLASH=y
CONFIG_FLASH_PAGE_LAYOUT=y
CONFIG_FLASH_MAP=y

# enable CALIBRATOR VERBOSE MODE, only when calibration is needed
CONFIG_ZMK_KSCAN_EC_MATRIX_VERBOSE_CALIBRATOR=y


# Takes a massive amount of RAM, be sure it is off.
CONFIG_FLASH_SHELL=n
CONFIG_SHELL_MINIMAL=y
CONFIG_ADC_SHELL=n

CONFIG_ZMK_COMBO_MAX_COMBOS_PER_KEY=2
CONFIG_ZMK_COMBO_MAX_KEYS_PER_COMBO=2

CONFIG_ISR_STACK_SIZE=1024
CONFIG_SHELL_STACK_SIZE=1024
CONFIG_SYSTEM_WORKQUEUE_STACK_SIZE=2048
CONFIG_USB_CDC_ACM_RINGBUF_SIZE=1024
```

## boards/shields/lpgalaxy_le_zapybara/Kconfig.defconfig
```kconfig
# SPDX-License-Identifier: MIT

#config BOARD_ENABLE_DCDC
#    bool "Enable DCDC mode"
#    select SOC_DCDC_NRF52X
#    default y
#    depends on BOARD_LPGALAXY_LE_ZAPYBARA


config SHIELD_LPGALAXY_LE_ZAPYBARA
    def_bool $(shields_list_contains,lpgalaxy_le_zapybara)
```
